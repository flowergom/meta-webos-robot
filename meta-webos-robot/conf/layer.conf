## meta-webos-robot/conf/layer.conf
```bitbake
# Copyright (c) 2021 LG Electronics, Inc.

BBPATH ?= ""
# We have a conf and classes directory, add to BBPATH
BBPATH .= ":${LAYERDIR}"
# We have a packages directory, add to BBFILES
BBFILES += "${LAYERDIR}/recipes-*/*/*.bb ${LAYERDIR}/recipes-*/*/*.bbappend"

BBFILE_COLLECTIONS += "meta-webos-robot"
BBFILE_PATTERN_meta-webos-robot := "^${LAYERDIR}/"
BBFILE_PRIORITY_meta-webos-robot = "80"

LAYERSERIES_COMPAT_meta-webos-robot = "dunfell"

WEBOS_TARGET_MACHINE_IMPL = "hardware"
```

## meta-webos-tegra/conf/layer.conf
```bitbake
# Copyright (c) 2021 LG Electronics, Inc.

BBPATH ?= ""
# We have a conf and classes directory, add to BBPATH
BBPATH .= ":${LAYERDIR}"

# We have a packages directory, add to BBFILES
BBFILES += "${LAYERDIR}/recipes-*/*/*.bb ${LAYERDIR}/recipes-*/*/*.bbappend"

BBFILE_COLLECTIONS += "meta-webos-tegra"
BBFILE_PATTERN_meta-webos-tegra := "^${LAYERDIR}/"
BBFILE_PRIORITY_meta-webos-tegra = "81"

LAYERSERIES_COMPAT_meta-webos-tegra = "dunfell"

# Set IMAGE_CLASSES and IMAGE_FSTYPES to easily flash the target board.
IMAGE_CLASSES += "image_types_tegra"
IMAGE_FSTYPES = "tegraflash tar.gz.bz2"
IMAGE_TYPES += "tegraflash"


# set cpio.gz.cboot to rootfs.cpio.gz.cboot as INITRAMFS_IMAGE_NAME for jetson-agx-xavier-devkit
INITRAMFS_FSTYPES_append_jetson-agx-xavier-devkit = "${@'' if d.getVar('INITRAMFS_IMAGE_BUNDLE') == '1' else ' rootfs.cpio.gz.cboot cpio.gz.cboot.bup-payload'}"

# Disable Sota feature for nvidia Socs
INHERIT_remove = "sota"
DISTRO_FEATURES_remove = "sota usrmerge"
DISTRO_FEATURES_NATIVE_remove = "sota"
```
